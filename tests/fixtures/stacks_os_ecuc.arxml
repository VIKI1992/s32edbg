AUTOSAR XML (schema 00046)
package /ActiveEcuC
  module config Os
    OsOS
      OsStackSummary
        3 x OsStack:
          TestA: OsStackSize=256, OsStackType=CORE_KERNEL_STACK, OsStackUserName=InitTask, OsStackUserName=TimerIsr, OsStackCore=OsCore0
          TestB: OsStackSize=96, OsStackType=TASK_EXTENDED_STACK, OsStackUserName=WorkerTask, OsStackCore=OsCore1
          Ghost: OsStackSize=512, OsStackType=TASK_EXTENDED_STACK, OsStackCore=OsCore0
